## config/west.yml
```yaml
manifest:
  remotes:
    - name: zmkfirmware
      url-base: https://github.com/zmkfirmware
  #additional module
    - name: infely
      url-base: https://github.com/infely
    - name: penguinchat
      url-base: https://github.com/penguinchat
  projects:
    - name: zmk
      remote: zmkfirmware
      revision: v0.3
      import: app/west.yml
  #additional module
    - name: nice-view-battery
      remote: infely
      revision: main
    - name: zmk-dongle-screen
      remote: penguinchat
      revision: Penguinchat-patch-1
    - name: zmk-for-PandaKB.com-
      remote: penguinchat
      revision: PandaKB_Lily58
  self:
    path: config
```
